
#include <stdio.h>
#include <string.h>
#include <math.h>
#include "Mini58Series.h"


#define  A0     P26
#define  RST    P25


#define X_WIDTH 132
#define Y_WIDTH 64


// 设备读写地址
#define        OPT3001_ADDR_READ                0x89
#define        OPT3001_ADDR_WRITE                0x88

float Lux;

unsigned char str_buff[20];				//显示缓存



//======================================================
// 128X64I液晶底层驱动[8X16]字体库
// 设计者: powerint
// 描  述: [8X16]西文字符的字模数据 (纵向取模,字节倒序)
// !"#$%&'()*+,-./0123456789:;<=>?@ABCDEFGHIJKLMNOPQRSTUVWXYZ[\]^_`abcdefghijklmnopqrstuvwxyz{|}~
//======================================================
const unsigned char  F8X16[]=
{
  0x00,0x00,0x00,0x00,0x00,0x00,0x00,0x00,0x00,0x00,0x00,0x00,0x00,0x00,0x00,0x00,// 0
  0x00,0x00,0x00,0xF8,0x00,0x00,0x00,0x00,0x00,0x00,0x00,0x33,0x30,0x00,0x00,0x00,//!1
  0x00,0x10,0x0C,0x06,0x10,0x0C,0x06,0x00,0x00,0x00,0x00,0x00,0x00,0x00,0x00,0x00,//"2
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  0x00,0x06,0x01,0x01,0x02,0x02,0x04,0x04,0x00,0x00,0x00,0x00,0x00,0x00,0x00,0x00,//~94

};

   
const unsigned char  F16X32_Idx[] = 
{
	"0123456789`CELx: "
};
const unsigned char  F16X32[]=
{
	0x00, 0x00, 0x80, 0xC0, 0xE0, 0xF0, 0x70, 0x38, 0x38, 0x78, 0xF0, 0xF0, 0xE0, 0xC0,
	0x00, 0x00, 0x00, 0xFC, 0xFF, 0xFF, 0xFF, 0x03, 0x00, 0x00, 0x00, 0x00, 0x00, 0x07,
	0xFF, 0xFF, 0xFF, 0xF0, 0x00, 0x1F, 0xFF, 0xFF, 0xFF, 0xE0, 0x00, 0x00, 0x00, 0x00,
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	0x00, 0x00, 0x00, 0x00, 0x00, 0x00, 0x00, 0x00,//空格
};


void OLED_WrCmd(unsigned char cmd)  
{        
       A0=0;
    SPI_WRITE_TX(SPI, cmd);
    SPI_TRIGGER(SPI);
    while(SPI_IS_BUSY(SPI));
}


void OLED_WrDat(unsigned char dat)
{
      A0=1;
    SPI_WRITE_TX(SPI, dat);
    SPI_TRIGGER(SPI);
    while(SPI_IS_BUSY(SPI));
}






void OLED_Set_Pos(unsigned char x,unsigned char y)
{    

    OLED_WrCmd(0xb0+y);
    OLED_WrCmd((x&0x0f));
    OLED_WrCmd(((x&0xf0)>>4)|0x10);
} 





void OLED_CLS(void)
{
   unsigned char y,x;	
	for(y = 0;y < 8;y++)
	{
		OLED_WrCmd(0xb0+y);
		OLED_WrCmd(0x10);
		OLED_WrCmd(0x00); 
		for(x=0;x < 132;x++)
			OLED_WrDat(0x00);
	}

}

//初始化OLED/////////////////////////////////////////////////////////////////////////
void OLED_Init(void)
{

  RST=0;
  CLK_SysTickDelay(10000);
  RST=1;
  CLK_SysTickDelay(20000);
  
	
 OLED_WrCmd(0xa2);//lcd bias select 1/9 BIAS
     OLED_WrCmd(0xa0);//ADC select,REVERSE 127-->0(a0,a1)//左右镜像
     OLED_WrCmd(0xc8);//com select,NORMAL 0-->63(c8,c0)//上下镜像
     OLED_WrCmd(0x22);//粗调对比度，可设置范围 0x20～0x27
     OLED_WrCmd(0x81);//微调对比度
     OLED_WrCmd(0x2d); //0x1a,微调对比度的值，可设置范围 0x00～0x3f
	   OLED_WrCmd(0xa6);//正显0xa6，反显0xa7
     OLED_WrCmd(0x2f);//power control(VB,VR,VF=1,1,1)
     OLED_WrCmd(0xaf);//set display on


OLED_CLS();
        
}



//==============================================================
//函数名：OLED_P8x16Str(unsigned char x,unsigned char y,unsigned char *p)
//功能描述：写入一组标准ASCII字符串
//参数：显示的位置（x,y），y为行范围0～35，要显示的字符串
//返回：无
//==============================================================  
void OLED_P8x16Str(unsigned char x,unsigned char y,unsigned char ch[])
{
  unsigned char c=0,i=0,j=0;
        
  while (ch[j]!='\0')
  {    
    c =ch[j]-32;
    OLED_Set_Pos(x,y);    
  	for(i=0;i<8;i++)     
  	  OLED_WrDat(F8X16[c*16+i]);
  	OLED_Set_Pos(x,y+1);    
  	for(i=0;i<8;i++)     
  	  OLED_WrDat(F8X16[c*16+i+8]);  
  	x+=8;
  	j++;
  }
}



//显示16x32大字温度
void OLED_P16x32Temp(unsigned char x,unsigned char y,unsigned char ch[])
{
  unsigned char c=0,i=0,j=0;
        
  while (ch[j]!='\0')
  {    
		if(ch[j]!='`' && ch[j]!='C' && ch[j]!='E' && ch[j]!='L' && ch[j]!='x' && ch[j]!=':' && ch[j]!=' ')
			c =ch[j]-48;
		else if(ch[j]=='`')
			c = 10;
		else if(ch[j]=='C')
			c = 11;
		else if(ch[j]=='E')
			c = 12;
		else if(ch[j]=='L')
			c = 13;
		else if(ch[j]=='x')
			c = 14;
		else if(ch[j]==':')
			c = 15;
    else if(ch[j]==' ')
			c = 16;

    OLED_Set_Pos(x,y);    
  	for(i=0;i<16;i++)     
  	  OLED_WrDat(F16X32[c*64+i]);
  	OLED_Set_Pos(x,y+1);    
  	for(i=0;i<16;i++)     
  	  OLED_WrDat(F16X32[c*64+i+16]);  
  	OLED_Set_Pos(x,y+2);    
  	for(i=0;i<16;i++)     
  	  OLED_WrDat(F16X32[c*64+i+32]); 
  	OLED_Set_Pos(x,y+3);    
  	for(i=0;i<16;i++)     
  	  OLED_WrDat(F16X32[c*64+i+48]); 
  	x+=16;
  	j++;
  }
}


void SYS_Init(void)
{
    /* Unlock protected registers */
    SYS_UnlockReg();

    /* Enable clock source */
    CLK_EnableXtalRC(CLK_PWRCTL_LIRCEN_Msk|CLK_PWRCTL_HIRCEN_Msk);

    /* Waiting for clock source ready */
    CLK_WaitClockReady(CLK_STATUS_LIRCSTB_Msk|CLK_STATUS_HIRCSTB_Msk);

    /* If the defines do not exist in your project, please refer to the related clk.h in the Header folder appended to the tool package. */
    /* Set HCLK clock */
    CLK_SetHCLK(CLK_CLKSEL0_HCLKSEL_HIRC, CLK_CLKDIV_HCLK(1));

    /* Enable IP clock */
    CLK_EnableModuleClock(I2C0_MODULE);
    CLK_EnableModuleClock(SPI0_MODULE);

    /* Set IP clock */
    CLK_SetModuleClock(SPI0_MODULE, CLK_CLKSEL1_SPISEL_HCLK, MODULE_NoMsk);
	
	   
	  /*---------------------------------------------------------------------------------------------------------*/
    /* Init I/O Multi-function                                                                                 */
    /*---------------------------------------------------------------------------------------------------------*/
    /* Set P3.4 and P3.5 for I2C SDA and SCL */
    SYS->P3_MFP = SYS_MFP_P34_I2C0_SDA | SYS_MFP_P35_I2C0_SCL;

     /* Setup SPI multi-function pin */
    SYS->P0_MFP |= SYS_MFP_P04_SPI0_SS | SYS_MFP_P05_SPI0_MOSI | SYS_MFP_P06_SPI0_MISO | SYS_MFP_P07_SPI0_CLK;
   
    /* Update System Core Clock */
    /* User can use SystemCoreClockUpdate() to calculate SystemCoreClock. */
    SystemCoreClockUpdate();

    /* Lock protected registers */
    SYS_LockReg();

  
}


void SPI_Init(void)
{
    /*---------------------------------------------------------------------------------------------------------*/
    /* Init SPI                                                                                                */
    /*---------------------------------------------------------------------------------------------------------*/
    /* Configure as a master, clock idle low, falling clock edge Tx, rising edge Rx and 32-bit transaction */
    /* Set IP clock divider. SPI clock rate = 8MHz */
    SPI_Open(SPI, SPI_MASTER, SPI_MODE_0, 8, 8000000);

    /* Enable the automatic hardware slave select function. Select the SS pin and configure as low-active. */
    SPI_EnableAutoSS(SPI, SPI_SS, SPI_SS_ACTIVE_LOW);
}


void I2C0_Init(void)
{
    /* Open I2C module and set bus clock */
    I2C_Open(I2C0, 100000);   
}


/*---------------------------------------------------------------------------------------------------------*/
/*  Function for System Entry to Power Down Mode                                                           */
/*---------------------------------------------------------------------------------------------------------*/
void PowerDownFunction(void)
{

    /* Enable Power-down mode wake-up interrupt */
    CLK->PWRCTL |= CLK_PWRCTL_PDWKIEN_Msk;

    /* Enter to Power-down mode */
    CLK_PowerDown();

}


/*---------------------------------------------------------------------------------------------------------*/
/*  Power Down Wake Up IRQ Handler                                                                         */
/*---------------------------------------------------------------------------------------------------------*/
void PDWU_IRQHandler(void)
{
    /* Clear Power Down Wake Up interrupt flag */
    CLK->PWRCTL |= CLK_PWRCTL_PDWKIF_Msk;

}


void GPIO01_IRQHandler(void)
{
    uint32_t reg;
    /* To check if P1.4 interrupt occurred */
    if (P1->INTSRC & BIT4)
    {
        P1->INTSRC = BIT4;

    }
    else
    {
        /* Un-expected interrupt. Just clear all PORT0, PORT1 interrupts */
        reg = P0->INTSRC;
        P0->INTSRC = reg;
        reg = P1->INTSRC;
        P1->INTSRC = reg;
    }
}


void OPT3001_WR_Reg(uint8_t u8Reg, uint16_t u8Data)
{
    /* 发送起始位 */
     I2C_SET_CONTROL_REG(I2C0, I2C_STA);              
     I2C_WAIT_READY(I2C0); 

    /* 写OPT3001从设备地址+写位 */
	  I2C_SET_DATA(I2C0, OPT3001_ADDR_WRITE);     
    I2C_SET_CONTROL_REG(I2C0, I2C_SI);
    I2C_WAIT_READY(I2C0);

    /* 写OPT3001寄存器地址 */
	  I2C_SET_DATA(I2C0, u8Reg); 
    I2C_SET_CONTROL_REG(I2C0, I2C_SI);
    I2C_WAIT_READY(I2C0);

    /* 写数据到OPT3001寄存器 */
	  I2C_SET_DATA(I2C0, ((uint8_t)(u8Data>>8)));
    I2C_SET_CONTROL_REG(I2C0, I2C_SI);
    I2C_WAIT_READY(I2C0);
	
	  /* 写数据到OPT3001寄存器 */
	  I2C_SET_DATA(I2C0, ((uint8_t)(u8Data&0x00ff)));
    I2C_SET_CONTROL_REG(I2C0, I2C_SI);
    I2C_WAIT_READY(I2C0);

    /* 发送停止位 */
    I2C_SET_CONTROL_REG(I2C0, I2C_STO | I2C_SI);

    CLK_SysTickDelay(10);
}






uint16_t OPT3001_READ(uint8_t Address)
{
    uint16_t buf;

    /* 发送起始位 */
    I2C_SET_CONTROL_REG(I2C0, I2C_STA);
    I2C_WAIT_READY(I2C0);


		I2C_SET_DATA(I2C0, OPT3001_ADDR_WRITE);   
    I2C_SET_CONTROL_REG(I2C0, I2C_SI);
    I2C_WAIT_READY(I2C0); 
	
	  I2C_SET_DATA(I2C0, Address);   
    I2C_SET_CONTROL_REG(I2C0, I2C_SI);
    I2C_WAIT_READY(I2C0);
	
    /* 发送停止位 */
    I2C_SET_CONTROL_REG(I2C0, I2C_STO | I2C_SI);
	
	
	  /* 发送起始位 */
    I2C_SET_CONTROL_REG(I2C0, I2C_STA);
    I2C_WAIT_READY(I2C0);
	
	  I2C_SET_DATA(I2C0, OPT3001_ADDR_READ);   
    I2C_SET_CONTROL_REG(I2C0, I2C_SI);
    I2C_WAIT_READY(I2C0);

    
    /* 读OPT3001寄存器数据并返回ACK */
    I2C_SET_CONTROL_REG(I2C0, I2C_SI | I2C_AA);
    I2C_WAIT_READY(I2C0);                       
    buf = I2C_GET_DATA(I2C0);                
    buf=buf<<8;                 //读取并保存高八位数据
	
	  /* 读OPT3001寄存器数据并返回NACK */
    I2C_SET_CONTROL_REG(I2C0,  I2C_SI);
    I2C_WAIT_READY(I2C0);                        
    buf+=0x00ff & I2C_GET_DATA(I2C0);     // 2个字节合成数据，即光照数据         

    /* 发送停止位 */
    I2C_SET_CONTROL_REG(I2C0, I2C_STO | I2C_SI);

    CLK_SysTickDelay(10);
    
    return buf;
}



	//OPT3001寄存器配置
	//12:15 RN  	- 配置测量光照的范围 见手册20页表9  当配置位1100传感器测量范围自动选择
	//11    CT  	- 测量时间配置 0- 100Ms  1-800Ms
	//10:9  M[1:0]	- 转换模式 00-关闭模式  01 - 单次转换  10、11 - 连续多次转换
	//8     OVF     - 测量光照超出设定的范围或最大测量值 溢出标志
	//7     CRF		- 转换就绪字段 1-转换完成
	//6     FH		- 转换的光照值 大于上限值 置位
	//5     FL		- 转换的光照值 小于下限值 置位
	//4     L		- 中断输出的两种模式  1-窗口模式 这种模式下高限置位和低限置位INT输出  0-滞后模式 高限置位INT输出 具体看手册
	//3     POL		- INT 中断被触发输出极性 0-拉低  1-拉高
	//2     ME 		- 掩码字段
	//0:1   FC		- 超出上限范围故障计数  如果超出次数 大于等于计数设定次数  INT输出中断



void OPT3001Config(void)
{
	OPT3001_WR_Reg(0x01, 0xce50);  //测量时间800Ms，转换的光照值大于上限值置位
	//OPT3001_WR_Reg(0x02, 0xbfff);  //设置触发下限
	OPT3001_WR_Reg(0x03, 0x0000);  //设置触发上限
}


//获取光强度得到的是放大100后的值占4个字节
unsigned long GetLuxValue()
{
 unsigned long Result=0;
 Result=OPT3001_READ(0x00);//读取
 Result=(1<<((Result& 0xF000)>>12))*(Result & 0x0FFF); //得到计算的值是真实值的100倍
 return Result;
	
}

int main(void)
{
	
	SYS_Init();

	SPI_Init();
	
	OLED_Init();
	
	I2C0_Init();
	
	OPT3001Config();
  


    /*  Configure P1.4 as Quasi-bidirection mode and enable interrupt by falling edge trigger */
    GPIO_SetMode(P1, BIT4, GPIO_MODE_QUASI);
    GPIO_EnableInt(P1, 4, GPIO_INT_FALLING);
    NVIC_EnableIRQ(GPIO01_IRQn);
		
		
		/* Unlock protected registers before setting Brown-out detector function and Power-down mode */
    SYS_UnlockReg();

    /* Enable Power-down wake-up interrupt */
    NVIC_EnableIRQ(PDWU_IRQn); 
	
	
	   
	while(1)
	{
	  OPT3001_READ(0x01);  //触发中断后需要读取配置寄存器才能清除标志位
	  Lux= (float)GetLuxValue()/100.0;
	
		sprintf((char *)str_buff ,"%5d",(uint16_t)Lux);
    OLED_P16x32Temp(15,0,str_buff);
    OLED_P8x16Str(103,1,"Lux");

    /* Enter to Power-down mode */
    PowerDownFunction();
		
		
	}
	
		
}
