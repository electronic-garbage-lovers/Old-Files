#include "ili9163.h"
#include <stdio.h>
#include <stdint.h> 
#include <sys/time.h>

#include "gpio.h"
#include "spi.h"

#include <linux/spi/spidev.h>

#include <sys/ioctl.h>


#define USE_ONCHIP_FLASH_FONT 1
const unsigned char asc16[] = {
#if USE_ONCHIP_FLASH_FONT
0x00,0x00,0x00,0x00,0x00,0x00,0x00,0x00,0x00,0x00,0x00,0x00,0x00,0x00,0x00,0x00, //" "
0x00,0x10,0x10,0x10,0x10,0x10,0x10,0x10,0x10,0x10,0x00,0x00,0x10,0x10,0x00,0x00, //"!"
0x00,0x00,0x6C,0x6C,0x24,0x24,0x00,0x00,0x00,0x00,0x01,0x00,0x00,0x00,0x00,0x00, //"""
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0x00,0x00,0x00,0x00,0x00,0x00,0x00,0x72,0x8C,0x00,0x00,0x00,0x00,0x00,0x00,0x00, //"~"
#endif
0x00,
};


void delay_ms(int ms);

void init_ili9163(void)
{
	pin_mod(LCD, GPIO_OUT);
	pin_mod(LCD, 1);

	ili9163_mode |= SPI_CPHA;
	ili9163_mode |= SPI_CPOL;
	ili9163_fd = init_spi(ili9163_device, ili9163_mode, ili9163_bits, ili9163_speed);

	pin_mod(LcdA0, GPIO_OUT);
	if (LcdRst > -1)
	{
		pin_mod(LcdRst, GPIO_OUT);
		pin_mod(LcdRst, 0);
		delay_ms(100);
		pin_mod(LcdRst, 1);
		delay_ms(50);
	}

    //------------------------------------ILI9163 --------------------------------------//
    LCD_WR_REG(0x11); //Exit Sleep
    delay_ms(120);

    LCD_WR_REG(0xEC);
    LCD_WR_DATA8(0x0C);

    LCD_WR_REG(0x26); //Set Default Gamma
    LCD_WR_DATA8(0x04);

    LCD_WR_REG(0xB1);
    LCD_WR_DATA8(0x0A);
    LCD_WR_DATA8(0x14);

    LCD_WR_REG(0xC0); //Set VRH1[4:0] & VC[2:0] for VCI1 & GVDD
    LCD_WR_DATA8(0x06);
    LCD_WR_DATA8(0x00);

    delay_ms(50);

    LCD_WR_REG(0xC1); //Set BT[2:0] for AVDD & VCL & VGH & VGL
    LCD_WR_DATA8(0x02);

    delay_ms(20);

    LCD_WR_REG(0xC5); //Set VMH[6:0] & VML[6:0] for VOMH & VCOML
    LCD_WR_DATA8(0x3C);
    LCD_WR_DATA8(0x00);

    delay_ms(20);

    LCD_WR_REG(0xC7);
    LCD_WR_DATA8(0xC3);

    LCD_WR_REG(0x3A); //Set Color Format
    LCD_WR_DATA8(0x05);

    LCD_WR_REG(0x2A); //Set Column Address
    LCD_WR_DATA8(0x00);
    LCD_WR_DATA8(0x00);
    LCD_WR_DATA8(0x00);
    LCD_WR_DATA8(0x7F);

    LCD_WR_REG(0x2B); //Set Page Address
    LCD_WR_DATA8(0x00);
    LCD_WR_DATA8(0x00);
    LCD_WR_DATA8(0x00);
    LCD_WR_DATA8(0x9F);

    LCD_WR_REG(0x36); //Set Scanning Direction
    LCD_WR_DATA8(0xC8);

    LCD_WR_REG(0xF2); //Enable Gamma bit
    LCD_WR_DATA8(0x01);

    LCD_WR_REG(0xE0);
    LCD_WR_DATA8(0x3F);//p1
    LCD_WR_DATA8(0x18);//p2
    LCD_WR_DATA8(0x18);//p3
    LCD_WR_DATA8(0x26);//p4
    LCD_WR_DATA8(0x20);//p5
    LCD_WR_DATA8(0x0D);//p6
    LCD_WR_DATA8(0x46);//p7
    LCD_WR_DATA8(0xF3);//p8
    LCD_WR_DATA8(0x32);//p9
    LCD_WR_DATA8(0x09);//p10
    LCD_WR_DATA8(0x02);//p11
    LCD_WR_DATA8(0x02);//p12
    LCD_WR_DATA8(0x00);//p13
    LCD_WR_DATA8(0x00);//p14
    LCD_WR_DATA8(0x00);//p15

    LCD_WR_REG(0xE1);
    LCD_WR_DATA8(0x00);//p1
    LCD_WR_DATA8(0x27);//p2
    LCD_WR_DATA8(0x27);//p3
    LCD_WR_DATA8(0x09);//p4
    LCD_WR_DATA8(0x0F);//p5
    LCD_WR_DATA8(0x12);//p6
    LCD_WR_DATA8(0x39);//p7
    LCD_WR_DATA8(0xC0);//p8
    LCD_WR_DATA8(0x4D);//p9
    LCD_WR_DATA8(0x16);//p10
    LCD_WR_DATA8(0x1D);//p11
    LCD_WR_DATA8(0x2D);//p12
    LCD_WR_DATA8(0x3F);//p13
    LCD_WR_DATA8(0x3F);//p14
    LCD_WR_DATA8(0x3F);//p15

    LCD_WR_REG(0x29); // Display On
    delay_ms(120);
    LCD_WR_REG(0x2c); // Display On

}

void delay_ms(int ms)
{
	struct timeval delay;
	delay.tv_sec = 0;
	delay.tv_usec = ms * 1000; // 20 ms
	select(0, NULL, NULL, NULL, &delay);
}

void LCD_WR_REG(unsigned char COM)
{
	char data[1];
	data[0] = COM;
	pin_mod(LcdA0, 0);
	spitx(ili9163_fd, data);
}

//LCD发送数据
void LCD_WR_DATA8(unsigned char Data)
{
	char data[1];
	data[0] = Data;
	pin_mod(LcdA0, 1);
	spitx(ili9163_fd, data);
}

void Lcd_Clear(unsigned short Color)
{
    unsigned int i, m;
    Lcd_SetRegion(0, 0, WIDCH - 1, HIGH - 1);
    LCD_WR_REG(0x2C);
    pin_mod(LcdA0, 1);
    for (i = 0; i < WIDCH; i++)
    {
        uint8_t tx[HIGH * 2];
        for (m = 0; m < HIGH; m++)
        {
            tx[m * 2] = Color >> 8;
            tx[m * 2 + 1] = Color;
        }
   //     delay_ms(1000);
 //       spitx(ili9163_fd, tx); 
        struct spi_ioc_transfer tr = {
        .tx_buf = (unsigned long)tx,
        .len = (sizeof(tx) / sizeof((tx)[0])),
        };

        m = ioctl(ili9163_fd, SPI_IOC_MESSAGE(1), &tr);

    }
}


/*************************************************
函数名：LCD_Set_Region
功能：设置lcd显示区域，在此区域写点数据自动换行
入口参数：xy起点和终点
返回值：无
*************************************************/
void Lcd_SetRegion(unsigned short x_start, unsigned short y_start, unsigned short x_end, unsigned short y_end)
{
    LCD_WR_REG(0x2a);
    LCD_WR_DATA8(0x00);
    LCD_WR_DATA8(x_start);
    LCD_WR_DATA8(0x00);
    LCD_WR_DATA8(x_end);

    LCD_WR_REG(0x2b);
    LCD_WR_DATA8(0x00);
    LCD_WR_DATA8(y_start + 0);
    LCD_WR_DATA8(0x00);
    LCD_WR_DATA8(y_end + 0);

    LCD_WR_REG(0x2c);

}


void Gui_DrawFont_GBK16(unsigned short x, unsigned short y, unsigned short fc, unsigned short bc, unsigned char* s)
{
    unsigned char i, j, x0,jj;
    uint64_t k;
    uint8_t tx[(16*8) * 2];
//    uint8_t tx2[(16 * 8  + 1) * 2];
//    k = *s;
    char* data = s;
    x0 = (sizeof(&s) / sizeof((s)[0])) + 1;
//    printf("%d\r\n", x0);
 //   printf(s);
//    printf("%d\r\n", sizeof(data));
//    printf("%d\r\n", sizeof(s[0]));
    jj = 0;
    while (jj==0)
    {
        k = *s;
//        printf("%d",s[x0]);
        
 /*       if (k == 13)
        {
            x = x0;
            y += 16;
        }*/
//        k = 0;
        if (k > 32) k -= 32; else k = 0;
        for (i = 0; i < 16; i++)
        {
            for (j = 0; j < 8; j++)
            {
                if (asc16[k * 16 + i] & (0x80 >> j))
                {
//                    if (i < 8) {
                        tx[(i * 8 + j) * 2] = fc >> 8;
                        tx[(i * 8 + j) * 2 + 1] = fc;
                        //                    tx[j * 2] = fc >> 8;
                        //                    tx[j * 2 + 1] = fc;
                        //                    Gui_DrawPoint(x + j, y + i, fc);
 //                   }
 //                   else {
 //                       tx2[((i-8) * 8 + j) * 2] = fc >> 8;
   //                     tx2[((i-8) * 8 + j) * 2 + 1] = fc;
    //                }
                }
                else
                {
      //              if (i < 8) {
                        tx[(i * 8 + j) * 2] = bc >> 8;
                        tx[(i * 8 + j) * 2 + 1] = bc;
                        //                    tx[j * 2] = bc >> 8;
                        //                    tx[j * 2 + 1] = bc;
                        //                    Gui_DrawPoint(x + j, y + i, bc);
       //             }
        //            else
          //          {
            //            tx2[((i - 8) * 8 + j) * 2] = bc >> 8;
              //          tx2[((i - 8) * 8 + j) * 2 + 1] = bc;
                //    }
                }
            }

            //Lcd_SetRegion(x, y+i-1, x + 8, y +i);
            //pin_mod(LcdA0, 1);

            //struct spi_ioc_transfer tr = {
            //.tx_buf = (unsigned long)tx,
            //.len = (sizeof(tx) / sizeof((tx)[0])),
            //};

            //j = ioctl(ili9163_fd, SPI_IOC_MESSAGE(1), &tr);
        }
        Lcd_SetRegion(x, y, x + 7, y + 16);   
        pin_mod(LcdA0, 1);

        struct spi_ioc_transfer tr = {
        .tx_buf = (unsigned long)tx,
        .len = (sizeof(tx) / sizeof((tx)[0])),
        };

        i = ioctl(ili9163_fd, SPI_IOC_MESSAGE(1), &tr);
//        struct spi_ioc_transfer tr2 = {
//        .tx_buf = (unsigned long)tx2,
//        .len = (sizeof(tx) / sizeof((tx)[0])),
//        };
            
//        i = ioctl(ili9163_fd, SPI_IOC_MESSAGE(1), &tr2);
//        spitx(ili9163_fd, tx);
        s++;
        x0++;
        x += 8;
        k = *s;
        if (k == '\0') jj = 1;
    }
    /*
    unsigned char i, j;
    unsigned short k, x0;
    x0 = x;
    {
        if ((*s) < 128)
        {
            k = *s;
            if (k == 13)
            {
                x = x0;
                y += 16;
            }
            else
            {
                if (k > 32) k -= 32; else k = 0;

                for (i = 0; i < 16; i++)
                    for (j = 0; j < 8; j++)
                    {
                        if (asc16[k * 16 + i] & (0x80 >> j))	Gui_DrawPoint(x + j, y + i, fc);
                        else
                        {
                            if (fc != bc) Gui_DrawPoint(x + j, y + i, bc);
                        }
                    }
                x += 8;
            }
            s++;
        }
    }*/

        //else
        //{


        //    for (k = 0; k < hz16_num; k++)
        //    {
        //        if ((hz16[k].Index[0] == *(s)) && (hz16[k].Index[1] == *(s + 1)))
        //        {
        //            for (i = 0; i < 16; i++)
        //            {
        //                for (j = 0; j < 8; j++)
        //                {
        //                    if (hz16[k].Msk[i * 2] & (0x80 >> j))	Gui_DrawPoint(x + j, y + i, fc);
        //                    else {
        //                        if (fc != bc) Gui_DrawPoint(x + j, y + i, bc);
        //                    }
        //                }
        //                for (j = 0; j < 8; j++)
        //                {
        //                    if (hz16[k].Msk[i * 2 + 1] & (0x80 >> j))	Gui_DrawPoint(x + j + 8, y + i, fc);
        //                    else
        //                    {
        //                        if (fc != bc) Gui_DrawPoint(x + j + 8, y + i, bc);
        //                    }
        //                }
        //            }
        //        }
        //    }
        //    s += 2; x += 16;
        //}

//    }
}


void Gui_DrawPoint(unsigned short x, unsigned short y, unsigned short Data)
{
    Lcd_SetRegion(x, y, x + 1, y + 1);
//    LCD_WriteData_16Bit(Data);
    LCD_WR_DATA8(Data >> 8);
    LCD_WR_DATA8(Data);
}
//颜色转换
unsigned short Color888to565(unsigned char r, unsigned char g, unsigned char b) {
    return ((b & 0xF8) << 8) | ((g & 0xFC) << 3) | (r >> 3);
}
